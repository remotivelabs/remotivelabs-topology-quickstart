VERSION "1.0"

NS_ :

BU_:
    SCCM
    BCM

BO_ 100 HazardLightButton: 1 SCCM
 SG_ HazardLightButton : 0|1@1+ (1,0) [0|1] ""  BCM

BO_ 101 HazardLightStatus: 1 BCM
 SG_ HazardLightActive : 0|1@1+ (1,0) [0|1] ""  SCCM

VAL_ 100 HazardLightButton 0 "Off" 1 "On";
VAL_ 101 HazardLightActive 0 "Off" 1 "On";

BA_DEF_ BO_ "GenMsgCycleTime" FLOAT 0 10000;

BA_ "GenMsgCycleTime" BO_ 100 50;
BA_ "GenMsgCycleTime" BO_ 101 50;
